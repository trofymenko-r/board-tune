## board_tune/hooks/hardware/Kconfig
```kconfig
config HARDWARE
	bool "Configure hardware interfaces"
	depends on PLATFORM_RPI
	help
	  Configure header I2C, SPI0, GPIO 1-Wire and additional UARTs at boot.
	  Check connected hardware and GPIO assignments before enabling them.

if HARDWARE

choice
	prompt "I2C (GPIO 2/3)"
	default HARDWARE_I2C_KEEP

config HARDWARE_I2C_KEEP
	bool "Keep current"

config HARDWARE_I2C_ENABLE
	bool "Enable"
	help
	  Enable the ARM header I2C bus and load i2c-dev at boot for /dev/i2c-*.

config HARDWARE_I2C_DISABLE
	bool "Disable"
	help
	  Disable the ARM header I2C bus. Other I2C buses and camera interfaces
	  are preserved. The shared i2c-dev module stays available for them.

endchoice

choice
	prompt "SPI0 (GPIO 7-11)"
	default HARDWARE_SPI_KEEP

config HARDWARE_SPI_KEEP
	bool "Keep current"

config HARDWARE_SPI_ENABLE
	bool "Enable"
	help
	  Enable the primary header SPI bus with its default chip selects.
	  Device overlays can replace spidev with their own drivers.

config HARDWARE_SPI_DISABLE
	bool "Disable"
	help
	  Disable the primary SPI bus. Additional SPI buses are preserved.

endchoice

choice
	prompt "1-Wire"
	default HARDWARE_ONEWIRE_KEEP

config HARDWARE_ONEWIRE_KEEP
	bool "Keep current"

config HARDWARE_ONEWIRE_ENABLE
	bool "Enable"
	help
	  Use the standard w1-gpio overlay. Check pin usage and the device's
	  pull-up wiring. No runtime GPIO changes are made.

config HARDWARE_ONEWIRE_DISABLE
	bool "Disable managed overlay"
	help
	  Remove board-tune's 1-Wire overlay. External overlays are preserved;
	  remove their configuration explicitly before disabling here.

endchoice

config HARDWARE_ONEWIRE_GPIO
	int "1-Wire GPIO (BCM)"
	depends on HARDWARE_ONEWIRE_ENABLE
	range 2 27
	default 4
	help
	  Use BCM GPIO numbers, not physical header pin numbers.
	  GPIO 0/1 are reserved for HAT identification and are not offered.

endif
```

## board_tune/hooks/network/Kconfig
```kconfig
config NETWORK
	bool "Configure Ethernet"
	help
	  Configure a wired Ethernet interface. Settings take effect on
	  the next boot, so a live board never loses its connection
	  halfway through.

if NETWORK

config NETWORK_IFACE
	string "Interface"
	default "eth0"

choice
	prompt "IPv4 mode"
	default NETWORK_DHCP

config NETWORK_DHCP
	bool "DHCP"

config NETWORK_STATIC
	bool "Static address"

endchoice

if NETWORK_STATIC

config NETWORK_ADDRESS
	string "IPv4 address / prefix"
	help
	  For example 192.168.1.50/24.

config NETWORK_GATEWAY
	string "Gateway"
	help
	  Leave empty for a network without a default route.

config NETWORK_DNS
	string "DNS servers"
	help
	  Space-separated list, e.g. "1.1.1.1 8.8.8.8".

endif

menu "Advanced"

choice
	prompt "Energy Efficient Ethernet (EEE)"
	default NETWORK_EEE_KEEP
	help
	  IEEE 802.3az wired Ethernet power saving. Requires ethtool and
	  driver support. A persistent per-interface policy applies on next
	  boot/device attachment and NetworkManager reconnect, never now.
	  Removing the policy returns control to the driver/network manager.
	  On BCM54213PE, running Device Tree restrictions at 100/1000 Mb/s
	  are imported as a disabled boot policy, separately from link state.

config NETWORK_EEE_KEEP
	bool "Keep existing policy"

config NETWORK_EEE_DISABLE
	bool "Disable EEE"

config NETWORK_EEE_ENABLE
	bool "Enable EEE"

config NETWORK_EEE_REMOVE
	bool "Remove board-tune EEE policy"

endchoice

choice
	prompt "Network backend"
	default NETWORK_BACKEND_AUTO

config NETWORK_BACKEND_AUTO
	bool "Automatic"
	help
	  NetworkManager when installed (Raspberry Pi OS Bookworm and
	  later), otherwise systemd-networkd.

config NETWORK_BACKEND_NM
	bool "NetworkManager"

config NETWORK_BACKEND_NETWORKD
	bool "systemd-networkd"

endchoice

endmenu

endif
```

## board_tune/hooks/serial_console/Kconfig
```kconfig
menuconfig SERIAL_CONSOLE
	bool "Serial console"
	help
	  Put the kernel console and a login prompt on the board's serial
	  port. Which UART is used is a board option shown below once a
	  board is selected.

if SERIAL_CONSOLE

config SERIAL_CONSOLE_BAUD
	int "Baud rate"
	default 115200

config SERIAL_CONSOLE_PRIMARY
	bool "Make the serial port the primary console"
	default y
	help
	  The last console= on the kernel command line becomes
	  /dev/console, which receives the systemd status output and the
	  emergency shell. Otherwise the display keeps that role.

config SERIAL_CONSOLE_VERBOSE
	bool "Full boot log"
	default y
	help
	  Remove "quiet" and "splash" from the kernel command line so
	  that the complete kernel and systemd boot log is printed.

config SERIAL_CONSOLE_LOGLEVEL
	int "Kernel console log level"
	depends on SERIAL_CONSOLE_VERBOSE
	range 1 8
	default 7
	help
	  Kernel messages with a priority below this level reach the
	  console. 7 shows everything but debug messages, 8 shows all.

config SERIAL_CONSOLE_AUTOLOGIN
	bool "Automatic login"
	help
	  Log in on the serial console without a password.

config SERIAL_CONSOLE_AUTOLOGIN_USER
	string "Automatic login user"
	depends on SERIAL_CONSOLE_AUTOLOGIN
	default "root"

endif
```

## board_tune/hooks/ssh/Kconfig
```kconfig
menuconfig SSH
	bool "SSH server"
	help
	  Configure the OpenSSH server.

if SSH

config SSH_ENABLE
	bool "Start the SSH server at boot"
	default y
	help
	  When disabled, whether the server starts is left unchanged.

config SSH_PORT
	int "Port"
	range 1 65535
	default 22

choice
	prompt "Root login"
	default SSH_ROOT_LOGIN_KEEP

config SSH_ROOT_LOGIN_KEEP
	bool "Distribution default"

config SSH_ROOT_LOGIN_NO
	bool "Not allowed"

config SSH_ROOT_LOGIN_KEY
	bool "Public key only"

config SSH_ROOT_LOGIN_YES
	bool "Allowed"

endchoice

choice
	prompt "Password authentication"
	default SSH_PASSWORD_AUTH_KEEP

config SSH_PASSWORD_AUTH_KEEP
	bool "Distribution default"

config SSH_PASSWORD_AUTH_YES
	bool "Allowed"

config SSH_PASSWORD_AUTH_NO
	bool "Disabled"

endchoice

config SSH_AUTHORIZED_KEYS
	string "Authorized keys file on this host"
	help
	  Public keys to authorize, e.g. ~/.ssh/id_ed25519.pub. They are
	  added to the user's authorized_keys; existing keys are kept.

config SSH_AUTHORIZED_KEYS_USER
	string "Authorize the keys for user"
	depends on SSH_AUTHORIZED_KEYS != ""
	default "root"

endif
```

## board_tune/hooks/system/Kconfig
```kconfig
config SYSTEM
	bool "Configure system settings"
	help
	  Set identity, localisation, time synchronisation and shell conveniences.
	  Empty fields keep the corresponding setting. Locale and keyboard changes take
	  effect for subsequent logins or after a reboot.

if SYSTEM

config SYSTEM_HOSTNAME
	string "Hostname (empty: keep)"

config SYSTEM_TIMEZONE
	string "Time zone (empty: keep)"
	help
	  IANA zone installed on the target, for example Europe/Kyiv.

config SYSTEM_LOCALE
	string "Default language / LANG (empty: keep)"
	help
	  UTF-8 locale, for example uk_UA.UTF-8 or en_US.UTF-8. Other LC_*
	  overrides are preserved. Offline generation runs on next boot.

menu "Keyboard"

config SYSTEM_KEYBOARD_LAYOUT
	string "Layout (empty: keep)"
	help
	  XKB layout or comma-separated layouts, for example us or us,ua.

config SYSTEM_KEYBOARD_VARIANT
	string "Variant"
	depends on SYSTEM_KEYBOARD_LAYOUT != ""

config SYSTEM_KEYBOARD_OPTIONS
	string "Options"
	depends on SYSTEM_KEYBOARD_LAYOUT != ""
	help
	  XKB options, for example grp:alt_shift_toggle.

endmenu

choice
	prompt "Time synchronisation"
	default SYSTEM_NTP_KEEP

config SYSTEM_NTP_KEEP
	bool "Keep current"

config SYSTEM_NTP_ENABLE
	bool "Enable systemd-timesyncd"

config SYSTEM_NTP_DISABLE
	bool "Disable systemd-timesyncd"

endchoice

config SYSTEM_NTP_SERVERS
	string "Custom NTP servers (empty: system defaults)"
	depends on SYSTEM_NTP_ENABLE
	help
	  Space-separated DNS names or IPv4/IPv6 addresses.

menu "Shell and terminal"

comment "Command aliases"

choice
	prompt "ll = ls -la (Bash)"
	default SYSTEM_ALIAS_LL_KEEP
	help
	  System-wide default for new interactive Bash sessions on Debian,
	  Ubuntu and Raspberry Pi OS. Personal shell configuration takes
	  precedence. Existing ll commands, functions and aliases are preserved.

config SYSTEM_ALIAS_LL_KEEP
	bool "Keep current"

config SYSTEM_ALIAS_LL_ENABLE
	bool "Enable default ll alias"

config SYSTEM_ALIAS_LL_REMOVE
	bool "Remove board-tune default ll alias"
	help
	  Remove only the block managed by board-tune. Personal and other
	  administrator-defined aliases are left alone. Existing shells keep
	  their aliases until a new session is opened.

endchoice

endmenu

endif
```

## board_tune/hooks/users/Kconfig
```kconfig
config USERS
	bool "Configure a user"
	help
	  Create or update one local user. Other accounts are preserved.
	  New accounts start with a locked password. Existing settings are
	  kept unless a change is explicitly requested below.

if USERS

config USERS_NAME
	string "User name"
	default "pi"

config USERS_CREATE
	bool "Create if missing"
	default y

config USERS_SHELL
	string "Login shell (empty: keep/default)"
	help
	  Leave empty to keep an existing shell or use /bin/bash for a
	  new account. The shell must be installed on the target.

choice
	prompt "Password"
	default USERS_PASSWORD_KEEP

config USERS_PASSWORD_KEEP
	bool "Keep current (new user: locked)"

config USERS_PASSWORD_LOCK
	bool "Lock password login"
	help
	  Disable password authentication for this account. This does
	  not revoke authorized SSH keys or terminate existing sessions.

config USERS_PASSWORD_HASH
	bool "Set password from a hash file"

endchoice

config USERS_PASSWORD_HASH_FILE
	string "Password hash file (on this computer)"
	depends on USERS_PASSWORD_HASH
	help
	  A file containing one encrypted password hash, such as one
	  generated with openssl passwd -6. The hash is not saved in
	  profiles or displayed in the change preview.

choice
	prompt "Additional groups"
	default USERS_GROUPS_KEEP

config USERS_GROUPS_KEEP
	bool "Keep current"

config USERS_GROUPS_ADD
	bool "Add to groups"

config USERS_GROUPS_REPLACE
	bool "Replace additional groups"

endchoice

config USERS_GROUPS
	string "Groups (space or comma separated)"
	depends on !USERS_GROUPS_KEEP
	help
	  Groups must already exist. Replace with an empty list removes
	  all supplementary memberships, keeping the primary group.

choice
	prompt "Sudo rule managed by board-tune"
	default USERS_SUDO_KEEP

config USERS_SUDO_KEEP
	bool "Keep current"

config USERS_SUDO_PASSWORD
	bool "Grant sudo with password"

config USERS_SUDO_NOPASSWD
	bool "Grant passwordless sudo"

config USERS_SUDO_REMOVE
	bool "Remove board-tune rule"
	help
	  Remove only board-tune's per-user sudo rule. Existing grants
	  from system groups or other sudoers files are preserved.

endchoice

menu "Advanced"

config USERS_UID
	int "UID for new user (0: automatic)"
	range 0 60000
	default 0
	help
	  Existing accounts cannot be renumbered. Automatic allocation
	  uses the target's UID_MIN/UID_MAX settings in /etc/login.defs.

config USERS_HOME
	string "Home for new user (empty: /home/USER)"
	help
	  Existing home directories cannot be moved by this hook.

endmenu

endif
```

## board_tune/hooks/wifi/Kconfig
```kconfig
config WIFI
	bool "Configure a Wi-Fi profile"
	help
	  Configure a NetworkManager station profile. Changes take effect
	  after reboot. Existing connections are not activated or removed.

if WIFI

config WIFI_IFACE
	string "Interface"
	default "wlan0"

config WIFI_SSID
	string "SSID"

choice
	prompt "Security"
	default WIFI_AUTH_PSK

config WIFI_AUTH_PSK
	bool "WPA2/WPA3 Personal"

config WIFI_AUTH_SAE
	bool "WPA3 Personal only"

config WIFI_AUTH_OPEN
	bool "Open network"

endchoice

config WIFI_PASSWORD_FILE
	string "Password file (on this computer; empty: keep stored key)"
	depends on !WIFI_AUTH_OPEN
	help
	  The passphrase is read from this file, never stored in profiles
	  or shown in diffs. Empty is allowed only if a matching SSID and
	  interface already have a stored password on the target.

config WIFI_COUNTRY
	string "Country code (empty: keep)"
	help
	  Two-letter ISO country where the board operates. Requires iw,
	  rfkill and the target's iso3166.tab. Applies on next boot.

config WIFI_HIDDEN
	bool "Hidden SSID"

config WIFI_AUTOCONNECT
	bool "Connect automatically"
	default y

config WIFI_PRIORITY
	int "Autoconnect priority"
	range -999 999
	default 100

menu "IPv4"

choice
	prompt "Address mode"
	default WIFI_DHCP

config WIFI_DHCP
	bool "DHCP"

config WIFI_STATIC
	bool "Static address"

endchoice

if WIFI_STATIC

config WIFI_ADDRESS
	string "IPv4 address / prefix"

config WIFI_GATEWAY
	string "Gateway"

config WIFI_DNS
	string "DNS servers"

endif

endmenu

endif
```
